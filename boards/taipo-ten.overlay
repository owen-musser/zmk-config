#include <dt-bindings/zmk/matrix.h>

/ {
    chosen {
        zmk,kscan = &kscan_0;
    };

    kscan_0: kscan {
        compatible = "zmk,kscan-gpio";
        label = "KSCAN";
        debounce-press-ms = <5>;
        debounce-release-ms = <5>;

        input-gpios =
            // Row 0
            <&gpio0 9 (GPIO_PULL_UP | GPIO_ACTIVE_LOW)>,  
            <&gpio0 8 (GPIO_PULL_UP | GPIO_ACTIVE_LOW)>,  
            <&gpio0 7 (GPIO_PULL_UP | GPIO_ACTIVE_LOW)>,  
            <&gpio0 6 (GPIO_PULL_UP | GPIO_ACTIVE_LOW)>,  
            <&gpio0 12 (GPIO_PULL_UP | GPIO_ACTIVE_LOW)>,  
            <&gpio0 13 (GPIO_PULL_UP | GPIO_ACTIVE_LOW)>,  
            <&gpio0 12 (GPIO_PULL_UP | GPIO_ACTIVE_LOW)>,  
            <&gpio0 11 (GPIO_PULL_UP | GPIO_ACTIVE_LOW)>,  
            <&gpio0 10 (GPIO_PULL_UP | GPIO_ACTIVE_LOW)>,  
            <&gpio0 13 (GPIO_PULL_UP | GPIO_ACTIVE_LOW)>;  
    };
};