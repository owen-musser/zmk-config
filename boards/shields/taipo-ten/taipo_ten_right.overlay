//#include <dt-bindings/zmk/matrix.h>

/ {
    chosen {
        zmk,kscan = &kscan_0;
    };

    kscan_0: kscan {
        compatible = "zmk,kscan-gpio";
        label = "KSCAN";
        debounce-press-ms = <5>;
        debounce-release-ms = <5>;

        input-gpios =
        
            <&gpio0 9 (GPIO_PULL_UP | GPIO_ACTIVE_LOW)>,  // 1
            <&gpio0 8 (GPIO_PULL_UP | GPIO_ACTIVE_LOW)>,  // 2 
            <&gpio0 7 (GPIO_PULL_UP | GPIO_ACTIVE_LOW)>,  // 3
            <&gpio0 6 (GPIO_PULL_UP | GPIO_ACTIVE_LOW)>,  // 4
            <&gpio0 12 (GPIO_PULL_UP | GPIO_ACTIVE_LOW)>, // 5 
            <&gpio0 13 (GPIO_PULL_UP | GPIO_ACTIVE_LOW)>, // 6 
            <&gpio0 12 (GPIO_PULL_UP | GPIO_ACTIVE_LOW)>, // 7 
            <&gpio0 11 (GPIO_PULL_UP | GPIO_ACTIVE_LOW)>, // 8
            <&gpio0 10 (GPIO_PULL_UP | GPIO_ACTIVE_LOW)>, // 9
            <&gpio0 13 (GPIO_PULL_UP | GPIO_ACTIVE_LOW)>; // 10 
    };
};