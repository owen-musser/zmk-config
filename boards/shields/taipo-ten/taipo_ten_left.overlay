//#include <dt-bindings/zmk/matrix.h>

/ {
    chosen {
        zmk,kscan = &kscan_0;
    };

    kscan_0: kscan {
        compatible = "zmk,kscan-gpio-direct";
        label = "KSCAN";
        debounce-press-ms = <5>;
        debounce-release-ms = <5>;

        input-gpios =
        
            <&pro_micro 18 (GPIO_PULL_UP | GPIO_ACTIVE_LOW)>,  // 1
            <&pro_micro 19 (GPIO_PULL_UP | GPIO_ACTIVE_LOW)>,  // 2 
            <&pro_micro 20 (GPIO_PULL_UP | GPIO_ACTIVE_LOW)>,  // 3
            <&pro_micro 21 (GPIO_PULL_UP | GPIO_ACTIVE_LOW)>,  // 4
            <&pro_micro 8 (GPIO_PULL_UP | GPIO_ACTIVE_LOW)>, // 5 
            <&pro_micro 10 (GPIO_PULL_UP | GPIO_ACTIVE_LOW)>, // 6 
            <&pro_micro 16 (GPIO_PULL_UP | GPIO_ACTIVE_LOW)>, // 7 
            <&pro_micro 14 (GPIO_PULL_UP | GPIO_ACTIVE_LOW)>, // 8
            <&pro_micro 15 (GPIO_PULL_UP | GPIO_ACTIVE_LOW)>, // 9
            <&pro_micro 9 (GPIO_PULL_UP | GPIO_ACTIVE_LOW)>; // 10 
    };
};